## overlay/package/python-adafruit-blinka/Config.in
```kconfig
config BR2_PACKAGE_PYTHON_ADAFRUIT_BLINKA
	bool "python-adafruit-blinka"
	select BR2_PACKAGE_PYTHON_ADAFRUIT_PLATFORMDETECT
	select BR2_PACKAGE_PYTHON_ADAFRUIT_PUREIO
	select BR2_PACKAGE_PYTHON_SYSV_IPC
	select BR2_PACKAGE_PYTHON_LGPIO
	select BR2_PACKAGE_PYTHON_RPI_LGPIO
	select BR2_PACKAGE_PYTHON_SPIDEV
	help
	  Adafruit Blinka CircuitPython compatibility layer.

	  https://github.com/adafruit/Adafruit_Blinka
```

## overlay/package/python-adafruit-circuitpython-busdevice/Config.in
```kconfig
config BR2_PACKAGE_PYTHON_ADAFRUIT_CIRCUITPYTHON_BUSDEVICE
	bool "python-adafruit-circuitpython-busdevice"
	select BR2_PACKAGE_PYTHON_ADAFRUIT_BLINKA
	help
	  Adafruit CircuitPython BusDevice helpers.

	  https://github.com/adafruit/Adafruit_CircuitPython_BusDevice
```

## overlay/package/python-adafruit-circuitpython-neopixel-spi/Config.in
```kconfig
config BR2_PACKAGE_PYTHON_ADAFRUIT_CIRCUITPYTHON_NEOPIXEL_SPI
	bool "python-adafruit-circuitpython-neopixel-spi"
	select BR2_PACKAGE_PYTHON_ADAFRUIT_BLINKA
        select BR2_PACKAGE_PYTHON_ADAFRUIT_CIRCUITPYTHON_PIXELBUF
        select BR2_PACKAGE_PYTHON_ADAFRUIT_CIRCUITPYTHON_BUSDEVICE
	help
	  Adafruit CircuitPython NeoPixel SPI driver.

	  https://github.com/adafruit/Adafruit_CircuitPython_NeoPixel_SPI
```

## overlay/package/python-adafruit-circuitpython-pixelbuf/Config.in
```kconfig
config BR2_PACKAGE_PYTHON_ADAFRUIT_CIRCUITPYTHON_PIXELBUF
	bool "python-adafruit-circuitpython-pixelbuf"
	help
	  Adafruit CircuitPython PixelBuf library.

	  https://github.com/adafruit/Adafruit_CircuitPython_Pixelbuf
```

## overlay/package/python-adafruit-platformdetect/Config.in
```kconfig
config BR2_PACKAGE_PYTHON_ADAFRUIT_PLATFORMDETECT
	bool "python-adafruit-platformdetect"
	help
	  Adafruit hardware platform detection library.

	  https://github.com/adafruit/Adafruit_Python_PlatformDetect
```

## overlay/package/python-adafruit-pureio/Config.in
```kconfig
config BR2_PACKAGE_PYTHON_ADAFRUIT_PUREIO
	bool "python-adafruit-pureio"
	help
	  Adafruit PureIO library.

	  https://github.com/adafruit/Adafruit_Python_PureIO
```

## overlay/package/python-argcomplete/Config.in
```kconfig
config BR2_PACKAGE_PYTHON_ARGCOMPLETE
	bool "python-argcomplete"
	help
	  Argcomplete provides easy, extensible command-line tab
	  completion for Python applications using argparse.

	  https://github.com/kislyuk/argcomplete
```

## overlay/package/python-pm-auto/Config.in
```kconfig
config BR2_PACKAGE_PYTHON_PM_AUTO
	bool "python-pm-auto"
	select BR2_PACKAGE_PYTHON_SF_RPI_STATUS
	select BR2_PACKAGE_PYTHON_EVDEV
	select BR2_PACKAGE_PYTHON_PILLOW
	select BR2_PACKAGE_PYTHON_SMBUS2
	select BR2_PACKAGE_PYTHON_NUMPY
	select BR2_PACKAGE_PYTHON_RPI_LGPIO
	select BR2_PACKAGE_PYTHON_ADAFRUIT_BLINKA
        select BR2_PACKAGE_PYTHON_ADAFRUIT_CIRCUITPYTHON_NEOPIXEL_SPI
	help
	  SunFounder Pironman automatic hardware-control library.

	  https://github.com/sunfounder/pm_auto
```

## overlay/package/python-sf-rpi-status/Config.in
```kconfig
config BR2_PACKAGE_PYTHON_SF_RPI_STATUS
	bool "python-sf-rpi-status"
	select BR2_PACKAGE_PYTHON_REQUESTS
	select BR2_PACKAGE_PYTHON_PSUTIL
	select BR2_PACKAGE_PYTHON_PYUDEV
	help
	  SunFounder Raspberry Pi status monitoring library.

	  https://github.com/sunfounder/sf_rpi_status
```

## overlay/package/python-sysv-ipc/Config.in
```kconfig
config BR2_PACKAGE_PYTHON_SYSV_IPC
	bool "python-sysv-ipc"
	help
	  Python interface to System V IPC.

	  https://github.com/osvenskan/sysv_ipc
```

## overlay/package/recalbox-pironman5/Config.in
```kconfig
config BR2_PACKAGE_RECALBOX_PIRONMAN5
	bool "recalbox-pironman5"
	depends on BR2_aarch64
	select BR2_PACKAGE_PYTHON3
	select BR2_PACKAGE_PYTHON_ARGCOMPLETE
        select BR2_PACKAGE_PYTHON_SF_RPI_STATUS
        select BR2_PACKAGE_PYTHON_PM_AUTO
        select BR2_PACKAGE_I2C_TOOLS
	select BR2_PACKAGE_LIRC_TOOLS
	help
	  SunFounder Pironman 5 support for Raspberry Pi 5.
```
